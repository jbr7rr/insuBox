## CMakeLists.txt
```
cmake_minimum_required(VERSION 3.20.0)

set(CMAKE_CXX_COMPILER /usr/bin/g++ CACHE PATH "" FORCE)
set(BOARD native_posix)
set(ZEPHYR_TOOLCHAIN_VARIANT zephyr)
set(TOOLCHAIN_ROOT ${ZEPHYR_BASE})
set(ZEPHYR_EXTRA_MODULES $ENV{ZEPHYR_BASE}/../insuBox/modules/googletest)

find_package(Zephyr REQUIRED HINTS $ENV{ZEPHYR_BASE})

project(tst)

# Add test sources
set(SOURCES
    src/main.cpp
    pump/medtrum/crypt/tst_Crypt.cpp
    pump/medtrum/comm/tst_WriteCommandPackets.cpp
    pump/medtrum/comm/packets/tst_MedtrumBasePacket.cpp
)

# Add these sources to your target
target_sources(app PRIVATE ${SOURCES})

# Link libraries
target_link_libraries(app PUBLIC gtest_main)
```

## prj.conf
```kconfig
CONFIG_GOOGLETEST=y

# Project libs
CONFIG_IB_PUMP=y
CONFIG_IB_PUMP_MEDTRUM=y

# Enable C++ support
CONFIG_CPP=y
CONFIG_STD_CPP17=y
CONFIG_LIB_CPLUSPLUS=y

CONFIG_LOG=y
```

## src/main.cpp
```c
#include "gtest/gtest.h"

extern "C" int main(void) {
    ::testing::InitGoogleTest();
    int ret = RUN_ALL_TESTS();
    return ret;
}
```
