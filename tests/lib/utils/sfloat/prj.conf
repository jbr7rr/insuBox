## CMakeLists.txt
```
cmake_minimum_required(VERSION 3.20.0)

set(ZEPHYR_EXTRA_MODULES $ENV{ZEPHYR_BASE}/../insuBox/modules/googletest)
find_package(Zephyr REQUIRED HINTS $ENV{ZEPHYR_BASE})

project(tst)

set(SOURCES
    src/main.cpp
    tst_sfloat.cpp
)

target_sources(app PRIVATE ${SOURCES})
target_link_libraries(app PUBLIC gtest_main)
```

## prj.conf
```kconfig
CONFIG_GOOGLETEST=y
CONFIG_TEST=y

# Project libs
CONFIG_IB_UTILS=y
CONFIG_IB_SFLOAT=y

# Enable C++ support
CONFIG_CPP=y
CONFIG_STD_CPP17=y
CONFIG_REQUIRES_FULL_LIBCPP=y
CONFIG_POSIX_THREADS=y

CONFIG_LOG=y
```

## src/main.cpp
```c
#include "gtest/gtest.h"

extern "C" int main(void)
{
    ::testing::InitGoogleTest();
    int ret = RUN_ALL_TESTS();
    return ret;
}
```
