## lib/pump/medtrum/Kconfig
```kconfig
config IB_PUMP_MEDTRUM
	select IB_PUMP
	bool "Medtrum insulin pump driver"
	help
	  This driver adds support for Medtrum insulin pumps.
```

## lib/pump/medtrum_bt/Kconfig
```kconfig
choice IB_PUMP_TYPE

config IB_PUMP_MEDTRUM_BT
	bool "Medtrum insulin pump BT driver"
	help
	  This option adds support for Medtrum insulin pumps, to control a remote medtrum pump using Bleutooth.

endchoice
```

## modules/googletest/Kconfig
```kconfig
menu "Google Test Configuration"

config GOOGLETEST
    bool "Enable Google Test support"
    help
      Enable Google Test framework.

endmenu
```

## tests/lib/events/testcase.yaml
```yaml
common:
  tags: extensibility
  integration_platforms:
    - native_posix
tests:
  lib.events: 
    harness: gtest
```

## tests/lib/testcase.yaml
```yaml
common:
  tags: extensibility
  integration_platforms:
    - native_posix
tests:
  lib.ib: 
    harness: gtest
```
