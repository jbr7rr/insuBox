## boards/insubox/insubox_rev_zero/Kconfig
```kconfig
config HEAP_MEM_POOL_ADD_SIZE_BOARD
	int
	default 4096 if BOARD_INSUBOX_REV_ZERO_ESP32S3_PROCPU
	default 256 if BOARD_INSUBOX_REV_ZERO_ESP32S3_APPCPU
```

## boards/insubox/insubox_rev_zero/Kconfig.insubox_rev_zero
```kconfig
# XIAO ESP32S3 board configuration

# Copyright (c) 2023 Seeed Studio inc.
# SPDX-License-Identifier: Apache-2.0

config BOARD_INSUBOX_REV_ZERO
	select SOC_ESP32S3_WROOM_N8
	select SOC_ESP32S3_PROCPU if BOARD_INSUBOX_REV_ZERO_ESP32S3_PROCPU
	select SOC_ESP32S3_APPCPU if BOARD_INSUBOX_REV_ZERO_ESP32S3_APPCPU
```

## boards/insubox/insubox_rev_zero/board.yml
```yaml
board:
  name: insubox_rev_zero
  full_name: InsuBox rev Zero
  vendor: Arasakeru
  socs:
  - name: esp32s3
```

## lib/Kconfig
```kconfig
rsource "ble/Kconfig"
rsource "control/Kconfig"
rsource "hmi/Kconfig"
rsource "pump/Kconfig"
rsource "utils/Kconfig"
```

## lib/ble/Kconfig
```kconfig
config IB_BLE_COMM
	bool "BLE communicaiton service"
	depends on BT
	help
	  Enable BLE communication service, which controls the BLE communication. (connecting, disconnecting, etc.)


if IB_BLE_COMM

config IB_BT_MAX_CLIENT_CONNECTIONS
	int "Maximum number of BLE client connections"
	default 1
	range 1 5
	help
	  Set the maximum number of BLE client connections. This is the maximum number of devices that can be connected to the device at the same time.

config BT_RX_STACK_SIZE
	default 4096

config BT_LONG_WQ_STACK_SIZE
	default 4096

endif # IB_BLE_COMM
```

## lib/control/Kconfig
```kconfig
config IB_CONTROL
    bool "InsuBox control module"
    help
        This option enables support for the InsuBox control module.

if IB_CONTROL

choice IB_CONTROL_IMPLEMENTATION
    prompt "Control device implementation"
    default IB_CONTROL_IDS

config IB_CONTROL_IDS
    bool "IDS (Insulin Delivery System) device"
    help
        Use the Bluetooth IDS GATT service for pump control.

config IB_CONTROL_KALEIDO
    bool "Kaleido device"
    help
        Use the Kaleido custom GATT service for pump control.

endchoice

endif # IB_CONTROL
```

## lib/hmi/Kconfig
```kconfig
config IB_HMI
    bool "InsuBox HMI module"
    help
        This option enables support for the InsuBox control module.

if IB_HMI

choice IB_HMI_TYPE
    prompt "InsuBox HMI Type"
    default IB_HMI_VIRTUAL

config IB_HMI_VIRTUAL
    bool "Virtual InsuBox HMI"
    help
        This option enables support for a virtual InsuBox HMI.
        WARNING: This option is not intended for production use.

endchoice

rsource "insubox/Kconfig"

config IB_HMI_STACK_SIZE
    int "InsuBox HMI stack size"
    default 2048
    help
        This option sets the stack size for the InsuBox HMI task.
        The default value is 2048 bytes.

endif
```

## lib/hmi/insubox/Kconfig
```kconfig
choice IB_HMI_TYPE

config IB_HMI_INSUBOX
	bool "InsuBox HMI"
	imply LVGL
	imply DISPLAY
	imply INPUT
	imply LV_USE_GRIDNAV
	imply LV_USE_FLOAT
	imply PM_DEVICE
	help
		This option enables support for the InsuBoxPump HMI.

endchoice

if IB_HMI_INSUBOX

# Override lvgl auto init
config LV_Z_AUTO_INIT
	default n

config IB_HMI_STACK_SIZE
    default 4096

config IB_HMI_DISPLAY_TIMEOUT_SEC
	int "InsuBox HMI display timeout"
	default 10
	help
		The display timeout in seconds. If there is no interaction in this time, it will turn off.

endif
```

## lib/pump/Kconfig
```kconfig
menu "Libraries"

config IB_PUMP
	bool "Insulin Pump"
    help
        This option enables support for insulin pumps.
        Note: This module is concerned with the insulin delivery, 
        certain parts of a hardware pump such as HMI will reside in their own modules.

if IB_PUMP

choice IB_PUMP_TYPE
    prompt "Insulin Pump Type"
    default IB_PUMP_VIRTUAL

config IB_PUMP_VIRTUAL
    bool "Virtual Insulin Pump"
    help
        This option enables support for a virtual insulin pump.

endchoice

endif

rsource "medtrum_bt/Kconfig"
rsource "insubox/Kconfig"

endmenu
```

## lib/pump/insubox/Kconfig
```kconfig
choice IB_PUMP_TYPE

config IB_PUMP_INSUBOX
	bool "InsuBox DIY pump"
	imply PWM
	imply STEPPER
	imply SENSOR
	imply I2C
	imply TMAG5273
	help
	  This option adds support for InsuBox DIY pump.

endchoice

if IB_PUMP_INSUBOX

config IB_PUMP_RESERVOIR_VOLUME
	int "InsuBox reservoir volume (units)"
	default 300
	range 1 600
	help
	  This option sets the reservoir volume for the InsuBox pump in units.
	  Valid values range from 1 to 600 units.
	  The default value is 300 units, which is equivalent to 3.00 ml.

choice IB_PUMP_INSUBOX_MOTOR_SPEC
	prompt "InsuBox motor specification"
	default IB_PUMP_INSUBOX_MOTOR_M3_1_298

config IB_PUMP_INSUBOX_MOTOR_M3_1_298
	bool "M3-1:298"

config IB_PUMP_INSUBOX_MOTOR_M3_1_50
	bool "M3-1:50"

endchoice

endif
```

## lib/utils/Kconfig
```kconfig
menu "Libraries"

config IB_UTILS
    bool "InsuBox Utilities"
    help
        This option enables support for InsuBox utilities.

rsource "sfloat/Kconfig"

endmenu
```

## lib/utils/sfloat/Kconfig
```kconfig
config IB_SFLOAT
    bool "Enable sfloat support"
    default y
    help
        Enable support for sfloat data type.
```

## tests/lib/hmi/testcase.yaml
```yaml
common:
  tags: extensibility
  integration_platforms:
    - native_sim/native/64
tests:
  lib.hmi: 
    harness: gtest
```

## tests/lib/pump/medtrum/Kconfig
```kconfig
source "Kconfig.zephyr"

config BT_MAX_CONN
    default 3

config IB_BT_MAX_CLIENT_CONNECTIONS
    default 1
```

## tests/lib/pump/medtrum/testcase.yaml
```yaml
common:
  tags: extensibility
  integration_platforms:
    - native_sim/native/64
tests:
  lib.pump.medtrum: 
    harness: gtest
```

## tests/lib/utils/sfloat/testcase.yaml
```yaml
common:
  tags: extensibility
  integration_platforms:
    - native_sim/native/64
tests:
  lib.utils.sfloat: 
    harness: gtest
```

## west.yml
```yaml
manifest:
  remotes:
    - name: zephyr
      url-base: https://github.com/zephyrproject-rtos

  projects:
    - name: zephyr
      remote: zephyr
      repo-path: zephyr
      revision: v4.2.0
      import: true
    - name: googletest
      url: https://github.com/google/googletest.git
      revision: main
      path: googletest
```
